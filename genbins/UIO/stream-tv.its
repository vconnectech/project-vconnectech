## genbins/UIO/stream-tv.its
```
/dts-v1/;
/ {
          description = "U-Boot fitImage for plnx_aarch64 kernel";
          #address-cells = <1>;
          images {
                       kernel@0 {
                                   description = "Linux Kernel";
                              //     data = /incbin/("/home/vconnect/Downloads/buildrootfiles/buildroot-2019.08/output/images/Image");
                                   data = /incbin/("./Image");
                                   type = "kernel";
                                   arch = "arm64";
                                   os = "linux";
                                   compression = "none";
                                   load = <0x80000>;
                                   entry = <0x80000>;
                                   hash@1 {
                                          algo = "sha1";
                                    };
                       };
                       fdt@0 {
                                  description = "Flattened Device Tree blob";
                              //   data = /incbin/("/home/vconnect/Downloads/buildrootfiles/buildroot-2019.08/output/build/linux-xilinx-v2019.1/arch/arm64/boot/dts/xilinx/zynqmp-zcu102-rev1.0.dtb");
                                // data = /incbin/("./system.dtb");
                                 data = /incbin/("./zynqmp-zcu102-rev1.0.dtb");
                                  type = "flat_dt";
                                  arch = "arm64";
                                  compression = "none";
                                  hash@1 {
                                         algo = "sha1";
                                  };
                      };
                      ramdisk@0 {
                                   description = "ramdisk";
                                   data = /incbin/("./ramdisk.image.gz");
                                   type = "ramdisk";
                                   arch = "arm64";
                                   os = "linux";
                                   compression = "none";
                                   hash@1 {
                                          algo = "sha1";
                                   };
                      };
};
      configurations {
             default = "conf@1";
             conf@1 {
                          description = "Boot Linux kernel with FDT blob + ramdisk";
                          kernel = "kernel@0";
                          fdt = "fdt@0";
                          ramdisk = "ramdisk@0";
                          hash@1 {
                                algo = "sha1";
                          };
	     };
	     conf@2 {
			 description = "Boot Linux kernel with FDT blob";
			 kernel = "kernel@0";
			 fdt = "fdt@0";
			 hash@1 {
			       algo = "sha1";
			 };
	     };
       };
};
```
